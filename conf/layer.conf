## conf/layer.conf
```bitbake
# We have a conf and classes directory, add to BBPATH
BBPATH .= ":${LAYERDIR}"

# We have recipes-* directories, add to BBFILES
BBFILES += "${LAYERDIR}/recipes-*/*/*.bb \
	${LAYERDIR}/recipes-*/*/*.bbappend"

BBFILE_COLLECTIONS += "caribou"
BBFILE_PATTERN_caribou = "^${LAYERDIR}/"
BBFILE_PRIORITY_caribou = "6"

LAYERDEPENDS_caribou = "xilinx"
```

## conf/machine/caribou-zynq7.conf
```bitbake
#@TYPE: Machine
#@NAME: caribou-zynq7
#@DESCRIPTION: Machine support for Caribou SoC board (based on Xilinx ZC706 Evaluation Board).
#

require conf/machine/include/tune-zynq.inc
require conf/machine/include/machine-xilinx-default.inc
require conf/machine/include/machine-xilinx-board.inc

MACHINE_FEATURES = "rtc ext2 ext3 vfat usbhost usbgadget"

# u-boot configuration
UBOOT_MACHINE = "zynq_zc706_config"
SPL_BINARY = "spl/boot.bin"

SERIAL_CONSOLE = "115200 ttyPS0"
EXTRA_IMAGEDEPENDS += "u-boot-zynq-uenv"

#Use MACHINE_DEVICETREE (compile using recipe)
MACHINE_ESSENTIAL_EXTRA_RDEPENDS += "device-tree"
EXTRA_IMAGEDEPENDS += "virtual/bitstream"

FORCE_PS7INIT = "caribou"

KERNEL_FEATURES += "features/rtc/rtc.scc"
IMAGE_BOOT_FILES += " \
		boot.bin \
		system-top.dtb \
		uEnv.txt \
		download.bit \
		"
```
